/*
 * The upstream settings_reset shield has one keymap binding but declares a 1x0
 * mock scan matrix. Give that matrix one logical position so ZMK does not
 * generate zero-length keymap arrays. The mock scanner still emits no events.
 */

&settings_reset_kscan {
    rows = <1>;
};
