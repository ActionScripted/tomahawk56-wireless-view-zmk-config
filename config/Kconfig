## config/Kconfig
```kconfig
menuconfig TOMAHAWK56_LAYER_RGB
    bool "Tomahawk56 per-key layer lighting"
    default y
    depends on ZMK_RGB_UNDERGLOW
    help
      Use the Tomahawk56's 28 addressable LEDs as a persistent per-key
      layer map with Dygma Defy-inspired colors.

config TOMAHAWK56_STUDIO_RESET_ON_FLASH
    bool "Drop the saved ZMK Studio keymap when new firmware is flashed"
    default y
    depends on ZMK_KEYMAP_SETTINGS_STORAGE
    help
      Drop ZMK Studio bindings on the first boot of each newly built image.
      Studio stores bindings outside the firmware image and reapplies them
      over the compiled keymap. Bluetooth pairings and other settings remain.
```

## config/dts/bindings/behaviors/zmk,behavior-layer-rgb-sync.yaml
```yaml
description: Tomahawk56 layer RGB synchronization and underglow controls

compatible: "zmk,behavior-layer-rgb-sync"

include: two_param.yaml
```

## config/west.yml
```yaml
manifest:
  remotes:
    - name: zmkfirmware
      url-base: https://github.com/zmkfirmware
    - name: tomahawk-keyboards
      url-base: https://github.com/Tomahawk-Keyboards
  projects:
    - name: zmk
      remote: tomahawk-keyboards
      revision: modify_backlight_layer
      import: app/west.yml
    - name: zmk-rgbled-widget
      remote: tomahawk-keyboards
      revision: main
  self:
    path: config
```
