#include "../behavior_keymap.dtsi"

/* After idle, a quick overlap must remain typing when the layer key releases first. */
&kscan {
    events = <
        ZMK_MOCK_PRESS(0,0,30)
        ZMK_MOCK_PRESS(0,1,30)
        ZMK_MOCK_RELEASE(0,0,30)
        ZMK_MOCK_RELEASE(0,1,10)
    >;
};
