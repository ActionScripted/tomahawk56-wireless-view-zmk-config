#include "../behavior_keymap.dtsi"

/*
 * A quick nested cross-hand sequence is indistinguishable from typing. The
 * second key's release must not force a layer before the 165 ms hold threshold.
 */
&kscan {
    events = <
        ZMK_MOCK_PRESS(0,0,30)
        ZMK_MOCK_PRESS(0,1,30)
        ZMK_MOCK_RELEASE(0,1,30)
        ZMK_MOCK_RELEASE(0,0,10)
    >;
};
