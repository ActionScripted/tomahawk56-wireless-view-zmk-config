#include "../behavior_keymap.dtsi"

/*
 * A deliberate chord started 155 ms in - short of the 165 ms term. It must
 * wait until the 165 ms hold threshold, then produce the symbol while held.
 */
&kscan {
    events = <
        ZMK_MOCK_PRESS(0,0,155)
        ZMK_MOCK_PRESS(0,1,30)
        ZMK_MOCK_RELEASE(0,1,30)
        ZMK_MOCK_RELEASE(0,0,10)
    >;
};
