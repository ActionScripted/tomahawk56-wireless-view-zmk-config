#include "../behavior_keymap.dtsi"

/* A quick same-hand sequence remains typing even when the target releases first. */
&kscan {
    events = <
        ZMK_MOCK_PRESS(0,0,30)
        ZMK_MOCK_PRESS(1,0,30)
        ZMK_MOCK_RELEASE(1,0,30)
        ZMK_MOCK_RELEASE(0,0,10)
    >;
};
