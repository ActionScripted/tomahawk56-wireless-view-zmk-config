#include "../behavior_keymap.dtsi"

/*
 * Same-hand overlap where the nested key is still held when the tapping term
 * expires. Activate at the hold threshold even though the target went down
 * early; this must not inherit the old same-hand veto.
 */
&kscan {
    events = <
        ZMK_MOCK_PRESS(0,0,30)
        ZMK_MOCK_PRESS(1,0,200)
        ZMK_MOCK_RELEASE(1,0,30)
        ZMK_MOCK_RELEASE(0,0,10)
    >;
};
