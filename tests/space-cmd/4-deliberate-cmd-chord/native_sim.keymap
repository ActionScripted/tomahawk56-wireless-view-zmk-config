#include "../behavior_keymap.dtsi"

/*
 * Space/Cmd held alone past the 225 ms term still resolves through the timer.
 * It must produce a Cmd+A chord, no space.
 */
&kscan {
    events = <
        ZMK_MOCK_PRESS(0,0,600)
        ZMK_MOCK_PRESS(0,1,30)
        ZMK_MOCK_RELEASE(0,1,30)
        ZMK_MOCK_RELEASE(0,0,10)
    >;
};
