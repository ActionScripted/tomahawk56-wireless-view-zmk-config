#include "../behavior_keymap.dtsi"

/*
 * The reported real-world misfire: after an idle pause, space is pressed and
 * the thumb rests on it while the next word starts, releasing ~150 ms in.
 * The interrupted roll must remain "space a".
 */
&kscan {
    events = <
        ZMK_MOCK_PRESS(0,0,100)
        ZMK_MOCK_PRESS(0,1,120)
        ZMK_MOCK_RELEASE(0,0,30)
        ZMK_MOCK_RELEASE(0,1,10)
    >;
};
