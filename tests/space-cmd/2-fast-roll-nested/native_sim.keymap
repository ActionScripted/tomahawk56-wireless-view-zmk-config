#include "../behavior_keymap.dtsi"

/*
 * A pressed and released while Space/Cmd remains down is a fast Cmd+A chord.
 * It must resolve on A's release without waiting for the tapping term.
 */
&kscan {
    events = <
        ZMK_MOCK_PRESS(0,0,30)
        ZMK_MOCK_PRESS(0,1,30)
        ZMK_MOCK_RELEASE(0,1,30)
        ZMK_MOCK_RELEASE(0,0,10)
    >;
};
