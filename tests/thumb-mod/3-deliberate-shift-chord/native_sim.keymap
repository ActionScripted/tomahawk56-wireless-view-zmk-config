#include "../behavior_keymap.dtsi"

/*
 * Holding the thumb alone past 175 ms still resolves Shift via the timer.
 */
&kscan {
    events = <
        ZMK_MOCK_PRESS(0,0,180)
        ZMK_MOCK_PRESS(0,1,30)
        ZMK_MOCK_RELEASE(0,1,30)
        ZMK_MOCK_RELEASE(0,0,10)
    >;
};
