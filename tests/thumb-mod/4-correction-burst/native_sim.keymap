#include "../behavior_keymap.dtsi"

/*
 * Tap Backspace, re-press 60 ms after the first press, and chord A. Both the
 * former 80 ms idle guard and 200 ms repeat window would veto this Shift.
 * The intended output is one Backspace followed by Shift+A on A's press.
 */
&kscan {
    events = <
        ZMK_MOCK_PRESS(0,0,40)
        ZMK_MOCK_RELEASE(0,0,20)
        ZMK_MOCK_PRESS(0,0,30)
        ZMK_MOCK_PRESS(0,1,30)
        ZMK_MOCK_RELEASE(0,1,30)
        ZMK_MOCK_RELEASE(0,0,10)
    >;
};
