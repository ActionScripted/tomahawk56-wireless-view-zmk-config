#include "../behavior_keymap.dtsi"

/*
 * A complete A tap nested inside the thumb press is an intentional fast chord.
 * Shift must resolve on A's press without waiting for its release or the timer.
 */
&kscan {
    events = <
        ZMK_MOCK_PRESS(0,0,30)
        ZMK_MOCK_PRESS(0,1,30)
        ZMK_MOCK_RELEASE(0,1,30)
        ZMK_MOCK_RELEASE(0,0,10)
    >;
};
