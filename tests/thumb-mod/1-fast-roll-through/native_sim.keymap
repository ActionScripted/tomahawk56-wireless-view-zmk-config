#include "../behavior_keymap.dtsi"

/* Shift activates on A down, even if the thumb comes up before A. */
&kscan {
    events = <
        ZMK_MOCK_PRESS(0,0,30)
        ZMK_MOCK_PRESS(0,1,40)
        ZMK_MOCK_RELEASE(0,0,30)
        ZMK_MOCK_RELEASE(0,1,10)
    >;
};
