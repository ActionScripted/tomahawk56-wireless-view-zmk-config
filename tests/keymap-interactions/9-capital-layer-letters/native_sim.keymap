#include "../behavior_keymap.dtsi"

/* Shift followed by a single home-row layer letter must type that capital, not start a layer. Cover all six letters and both Shift thumbs, then an unshifted apostrophe. */
&kscan {
    events = <
        ZMK_MOCK_PRESS(1,2,30)
        ZMK_MOCK_PRESS(0,0,30)
        ZMK_MOCK_RELEASE(0,0,30)
        ZMK_MOCK_RELEASE(1,2,20)
        ZMK_MOCK_PRESS(2,0,30)
        ZMK_MOCK_RELEASE(2,0,300)
        ZMK_MOCK_PRESS(1,2,30)
        ZMK_MOCK_PRESS(0,1,30)
        ZMK_MOCK_RELEASE(0,1,30)
        ZMK_MOCK_RELEASE(1,2,20)
        ZMK_MOCK_PRESS(2,0,30)
        ZMK_MOCK_RELEASE(2,0,300)
        ZMK_MOCK_PRESS(1,3,30)
        ZMK_MOCK_PRESS(0,2,30)
        ZMK_MOCK_RELEASE(0,2,30)
        ZMK_MOCK_RELEASE(1,3,20)
        ZMK_MOCK_PRESS(2,0,30)
        ZMK_MOCK_RELEASE(2,0,300)
        ZMK_MOCK_PRESS(1,3,30)
        ZMK_MOCK_PRESS(0,3,30)
        ZMK_MOCK_RELEASE(0,3,30)
        ZMK_MOCK_RELEASE(1,3,20)
        ZMK_MOCK_PRESS(2,0,30)
        ZMK_MOCK_RELEASE(2,0,300)
        ZMK_MOCK_PRESS(1,2,30)
        ZMK_MOCK_PRESS(1,0,30)
        ZMK_MOCK_RELEASE(1,0,30)
        ZMK_MOCK_RELEASE(1,2,20)
        ZMK_MOCK_PRESS(2,0,30)
        ZMK_MOCK_RELEASE(2,0,300)
        ZMK_MOCK_PRESS(1,3,30)
        ZMK_MOCK_PRESS(1,1,30)
        ZMK_MOCK_RELEASE(1,1,30)
        ZMK_MOCK_RELEASE(1,3,20)
        ZMK_MOCK_PRESS(2,0,30)
        ZMK_MOCK_RELEASE(2,0,300)
    >;
};
