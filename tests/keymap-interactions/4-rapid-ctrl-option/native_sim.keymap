#include "../behavior_keymap.dtsi"

/* Both Ctrl and Option thumbs must still tap their normal keys, then resolve a modifier on a rapid re-press after typing. No idle or repeat veto may emit another tap. */
&kscan {
    events = <
        ZMK_MOCK_PRESS(3,0,10)
        ZMK_MOCK_RELEASE(3,0,20)
        ZMK_MOCK_PRESS(2,1,20)
        ZMK_MOCK_RELEASE(2,1,20)
        ZMK_MOCK_PRESS(2,1,30)
        ZMK_MOCK_PRESS(2,0,30)
        ZMK_MOCK_RELEASE(2,0,30)
        ZMK_MOCK_RELEASE(2,1,300)
        ZMK_MOCK_PRESS(3,0,10)
        ZMK_MOCK_RELEASE(3,0,20)
        ZMK_MOCK_PRESS(2,2,20)
        ZMK_MOCK_RELEASE(2,2,20)
        ZMK_MOCK_PRESS(2,2,30)
        ZMK_MOCK_PRESS(2,0,30)
        ZMK_MOCK_RELEASE(2,0,30)
        ZMK_MOCK_RELEASE(2,2,300)
        ZMK_MOCK_PRESS(3,0,10)
        ZMK_MOCK_RELEASE(3,0,20)
        ZMK_MOCK_PRESS(3,1,20)
        ZMK_MOCK_RELEASE(3,1,20)
        ZMK_MOCK_PRESS(3,1,30)
        ZMK_MOCK_PRESS(2,0,30)
        ZMK_MOCK_RELEASE(2,0,30)
        ZMK_MOCK_RELEASE(3,1,300)
        ZMK_MOCK_PRESS(3,0,10)
        ZMK_MOCK_RELEASE(3,0,20)
        ZMK_MOCK_PRESS(3,2,20)
        ZMK_MOCK_RELEASE(3,2,20)
        ZMK_MOCK_PRESS(3,2,30)
        ZMK_MOCK_PRESS(2,0,30)
        ZMK_MOCK_RELEASE(2,0,30)
        ZMK_MOCK_RELEASE(3,2,300)
    >;
};
